## meta-bhavin/conf/layer.conf
```bitbake
# We have a conf and classes directory, add to BBPATH
BBPATH .= ":${LAYERDIR}"

# We have recipes-* directories, add to BBFILES
#BBFILES += "${LAYERDIR}/recipes-*/*/*.bb \
#            ${LAYERDIR}/recipes-*/*/*.bbappend"

BBFILES += "${LAYERDIR}/recipes-*/*/*.bb \
            ${LAYERDIR}/recipes-*/*/*/*.bb \
            ${LAYERDIR}/recipes-*/*/*.bbappend \
            ${LAYERDIR}/recipes-*/*/*/*.bbappend"


BBFILE_COLLECTIONS += "meta-bhavin"
BBFILE_PATTERN_meta-bhavin = "^${LAYERDIR}/"
BBFILE_PRIORITY_meta-bhavin = "6"

LAYERDEPENDS_meta-bhavin = "core phosphor-layer"
LAYERSERIES_COMPAT_meta-bhavin = "walnascar"
```
